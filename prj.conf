## CMakeLists.txt
```
# SPDX-License-Identifier: Apache-2.0

cmake_minimum_required(VERSION 3.20.0)

find_package(Zephyr REQUIRED HINTS $ENV{ZEPHYR_BASE})
project(sockets_wireguard)

target_sources(                     app PRIVATE src/wg_main.c)
target_sources(                     app PRIVATE src/dhcpc.c)
target_sources_ifdef(CONFIG_NET_UDP app PRIVATE src/wg_comm.c)
target_sources(                     app PRIVATE src/wg_tun.c)
target_sources(                     app PRIVATE src/wireguard_vpn.c)
target_sources(                     app PRIVATE src/wireguardif.c)
target_sources(                     app PRIVATE src/wireguard.c)
target_sources(                     app PRIVATE src/wireguard-platform.c)
target_sources(                     app PRIVATE src/wg_timer.c)
target_sources(                     app PRIVATE src/crypto.c)
target_sources(                     app PRIVATE src/crypto/blake2s.c)
target_sources(                     app PRIVATE src/crypto/chacha20.c)
target_sources(                     app PRIVATE src/crypto/chacha20poly1305.c)
target_sources(                     app PRIVATE src/crypto/poly1305-donna.c)
target_sources(                     app PRIVATE src/crypto/x25519.c)

include(${ZEPHYR_BASE}/samples/net/common/common.cmake)

set(gen_dir ${ZEPHYR_BINARY_DIR}/include/generated/)

foreach(inc_file)
  generate_inc_file_for_target(
    app
    src/${inc_file}
    ${gen_dir}/${inc_file}.inc
    )
endforeach()
```

## Kconfig
```
# Private config options for wireguard app

# Copyright (c) 2024 Chunghan Yi <chunghan.yi@gmail.com>
# Copyright (c) 2018 Intel Corporation
# SPDX-License-Identifier: Apache-2.0

mainmenu "Networking wireguard application"

config NET_CONFIG_VPN_IPV4_ADDR
	string "My IPv4 address for virtual interface"
	help
	  The value depends on your network setup.

config NET_CONFIG_VPN_IPV4_NETMASK
	string "My IPv4 netmask for virtual interface"
	help
	  The value depends on your network setup.

source "Kconfig.zephyr"
```

## sample.yaml
```
common:
  harness: net
  tags:
    - net
    - socket
  depends_on: netif
  min_flash: 140
sample:
  description: wireguard sample
  name: wireguard based on udp socket & tunnel interface
tests:
  sample.net.sockets.wireguard:
    platform_allow:
      - qemu_x86
      - qemu_x86_64
      - sam_e70_xplained/same70q21
      - frdm_k64f
      - qemu_cortex_m3
      - frdm_kw41z
      - nucleo_f207zg
      - qemu_cortex_a53
      - native_sim
    integration_platforms:
      - qemu_x86
  sample.net.sockets.echo_server.802154:
    extra_args: OVERLAY_CONFIG="overlay-qemu_802154.conf"
    platform_allow: qemu_x86
    integration_platforms:
      - qemu_x86
  sample.net.sockets.echo_server.802154.rf2xx.xplained:
    extra_args:
      - SHIELD=atmel_rf2xx_xplained
      - OVERLAY_CONFIG="overlay-802154.conf"
    platform_allow: sam4s_xplained
  sample.net.sockets.echo_server.802154.rf2xx.xpro:
    extra_args:
      - SHIELD=atmel_rf2xx_xpro
      - OVERLAY_CONFIG="overlay-802154.conf"
    platform_allow:
      - sam4e_xpro
      - sam_v71_xult/samv71q21
    integration_platforms:
      - sam_v71_xult/samv71q21
  sample.net.sockets.echo_server.802154.rf2xx.legacy:
    extra_args:
      - SHIELD=atmel_rf2xx_legacy
      - OVERLAY_CONFIG="overlay-802154.conf"
    platform_allow:
      - sam4e_xpro
      - sam_v71_xult/samv71q21
    integration_platforms:
      - sam_v71_xult/samv71q21
  sample.net.sockets.echo_server.802154.rf2xx.arduino:
    extra_args:
      - SHIELD=atmel_rf2xx_arduino
      - OVERLAY_CONFIG="overlay-802154.conf"
    platform_allow:
      - sam_v71_xult/samv71q21
      - frdm_k64f
      - nucleo_f767zi
    integration_platforms:
      - sam_v71_xult/samv71q21
  sample.net.sockets.echo_server.802154.rf2xx.mikrobus:
    extra_args:
      - SHIELD=atmel_rf2xx_mikrobus
      - OVERLAY_CONFIG="overlay-802154.conf"
    platform_allow: lpcxpresso55s69/lpc55s69/cpu0/ns
  sample.net.sockets.echo_server.mcr20a:
    extra_args:
      - SHIELD=frdm_cr20a
      - OVERLAY_CONFIG=overlay-802154.conf
    platform_allow: frdm_k64f
  sample.net.sockets.echo_server.nrf_802154:
    extra_args: OVERLAY_CONFIG="overlay-802154.conf"
    platform_allow: nrf52840dk/nrf52840
  sample.net.sockets.echo_server.b91_802154:
    extra_args: OVERLAY_CONFIG="overlay-802154.conf"
    platform_allow: tlsr9518adk80d
  sample.net.sockets.echo_server.usbnet:
    depends_on: usb_device
    harness: net
    extra_args: OVERLAY_CONFIG="overlay-netusb.conf"
    tags:
      - net
      - usb
    # native_sim usb driver does not work with CONFIG_POSIX_API
    platform_exclude:
      - native_sim
      - native_sim/native/64
      - native_posix
      - native_posix/native/64
  sample.net.sockets.echo_server.nrf_openthread:
    extra_args: OVERLAY_CONFIG="overlay-ot.conf"
    slow: true
    tags:
      - net
      - openthread
    platform_allow: nrf52840dk/nrf52840
    filter: CONFIG_FULL_LIBC_SUPPORTED and not CONFIG_NATIVE_LIBC
  sample.net.sockets.echo_server.b91_openthread:
    extra_args: OVERLAY_CONFIG="overlay-ot.conf"
    slow: true
    tags:
      - net
      - openthread
    platform_allow: tlsr9518adk80d
    filter: CONFIG_FULL_LIBC_SUPPORTED and not CONFIG_NATIVE_LIBC
  sample.net.sockets.echo_server.kw41z_openthread:
    extra_args: OVERLAY_CONFIG="overlay-ot.conf"
    slow: true
    tags:
      - net
      - openthread
    platform_allow: frdm_kw41z
    filter: CONFIG_FULL_LIBC_SUPPORTED and not CONFIG_NATIVE_LIBC
  sample.net.sockets.echo_server.e1000:
    extra_args: OVERLAY_CONFIG="overlay-e1000.conf"
    tags: net
    platform_allow:
      - qemu_x86
      - qemu_x86_64
  sample.net.sockets.echo_server.stellaris:
    extra_args: OVERLAY_CONFIG="overlay-qemu_cortex_m3_eth.conf"
    tags: net
    platform_allow: qemu_cortex_m3
  sample.net.sockets.echo_server.smsc911x:
    extra_args: OVERLAY_CONFIG="overlay-smsc911x.conf"
    tags: net
    platform_allow: mps2/an385
  sample.net.sockets.echo_server.userspace:
    extra_args:
      - CONFIG_USERSPACE=y
      - OVERLAY_CONFIG="overlay-e1000.conf"
      - CONFIG_MAX_THREAD_BYTES=3
    platform_allow:
      - qemu_x86
      - qemu_x86_64
    integration_platforms:
      - qemu_x86
  sample.net.sockets.echo_server.nsos:
    platform_allow:
      - native_sim
    extra_args:
      - OVERLAY_CONFIG="overlay-nsos.conf"
```

## prj.conf
```kconfig
# Generic networking options
CONFIG_NETWORKING=y
CONFIG_NET_UDP=y
CONFIG_NET_IPV4=y
CONFIG_NET_DHCPV4=y
CONFIG_NET_DHCPV4_OPTION_CALLBACKS=y
CONFIG_NET_SOCKETS=y
CONFIG_POSIX_API=y
CONFIG_NET_CONNECTION_MANAGER=y

CONFIG_NET_L2_ETHERNET=y
CONFIG_NET_L2_VIRTUAL=y
CONFIG_NET_L2_VIRTUAL_MGMT=y
CONFIG_NET_MGMT=y
CONFIG_NET_MGMT_EVENT=y

# Kernel options
CONFIG_MAIN_STACK_SIZE=4096
CONFIG_ENTROPY_GENERATOR=y
CONFIG_TEST_RANDOM_GENERATOR=y
CONFIG_INIT_STACKS=y

# Logging
CONFIG_NET_LOG=y
CONFIG_LOG=y
CONFIG_NET_STATISTICS=y
CONFIG_PRINTK=y

# Network buffers
CONFIG_NET_PKT_RX_COUNT=16
CONFIG_NET_PKT_TX_COUNT=16
CONFIG_NET_BUF_RX_COUNT=64
CONFIG_NET_BUF_TX_COUNT=64
CONFIG_NET_CONTEXT_NET_PKT_POOL=y

# IP address options
#CONFIG_NET_IF_UNICAST_IPV6_ADDR_COUNT=3
#CONFIG_NET_IF_MCAST_IPV6_ADDR_COUNT=4
CONFIG_NET_IF_MAX_IPV6_COUNT=5
CONFIG_NET_IF_MAX_IPV4_COUNT=5
CONFIG_NET_MAX_CONTEXTS=10

# Network shell
CONFIG_NET_SHELL=y
CONFIG_SHELL=y

# Network application options and configuration
CONFIG_NET_CONFIG_SETTINGS=y
#CONFIG_NET_CONFIG_NEED_IPV6=y
#CONFIG_NET_CONFIG_MY_IPV6_ADDR="2001:db8::1"
#CONFIG_NET_CONFIG_PEER_IPV6_ADDR="2001:db8::2"
CONFIG_NET_CONFIG_NEED_IPV4=y
CONFIG_NET_CONFIG_MY_IPV4_ADDR="192.168.8.50"
CONFIG_NET_CONFIG_MY_IPV4_NETMASK="255.255.255.0"
CONFIG_NET_CONFIG_PEER_IPV4_ADDR="192.168.8.1"

CONFIG_NET_CONFIG_VPN_IPV4_ADDR="10.1.1.50"
CONFIG_NET_CONFIG_VPN_IPV4_NETMASK="255.255.255.0"

# Number of socket descriptors might need adjusting
# if there are more than 1 handlers defined.
CONFIG_ZVFS_OPEN_MAX=12

# How many client can connect to echo-server simultaneously
#CONFIG_NET_SAMPLE_NUM_HANDLERS=1
```

## src/common.h
```c
/*
 * Copyright (c) 2024 Chunghan Yi <chunghan.yi@gmail.com>
 * Copyright (c) 2018 Nordic Semiconductor ASA.
 * Copyright (c) 2017-2019 Intel Corporation.
 *
 * SPDX-License-Identifier: Apache-2.0
 */

#ifndef _COMMON_H_
#define _COMMON_H_

#define WG_PORT 52840
#define STACK_SIZE 4096

#if defined(CONFIG_NET_TC_THREAD_COOPERATIVE)
#define THREAD_PRIORITY K_PRIO_COOP(CONFIG_NUM_COOP_PRIORITIES - 1)
#else
#define THREAD_PRIORITY K_PRIO_PREEMPT(8)
#endif

#define RECV_BUFFER_SIZE 2048
#define STATS_TIMER 60 /* How often to print statistics (in seconds) */

#if defined(CONFIG_USERSPACE)
#include <zephyr/app_memory/app_memdomain.h>
extern struct k_mem_partition app_partition;
extern struct k_mem_domain app_domain;
#define APP_BMEM K_APP_BMEM(app_partition)
#define APP_DMEM K_APP_DMEM(app_partition)
#else
#define APP_BMEM
#define APP_DMEM
#endif

struct data {
	const char *proto;

	struct {
		int sock;
		char recv_buffer[RECV_BUFFER_SIZE];
		uint32_t counter;
		atomic_t bytes_received;
		struct k_work_delayable stats_print;
	} udp;
};

struct configs {
	struct data ipv4;
};

extern struct configs conf;

void start_udp(void);
void stop_udp(void);
void quit(void);
int init_tunnel(void);

#endif /*_COMMON_H_*/
```

## src/crypto.c
```c
/*
 * Porting for Zephyr RTOS
 * Copyright (C) 2024 Chunghan.Yi(chunghan.yi@gmail.com)
 */
/*
 * Copyright (c) 2021 Daniel Hope (www.floorsense.nz)
 * All rights reserved.
 *
 * Redistribution and use in source and binary forms, with or without modification,
 * are permitted provided that the following conditions are met:
 *
 * 1. Redistributions of source code must retain the above copyright notice, this
 *  list of conditions and the following disclaimer.
 *
 * 2. Redistributions in binary form must reproduce the above copyright notice, this
 *  list of conditions and the following disclaimer in the documentation and/or
 *  other materials provided with the distribution.
 *
 * 3. Neither the name of "Floorsense Ltd", "Agile Workspace Ltd" nor the names of
 *  its contributors may be used to endorse or promote products derived from this
 *   software without specific prior written permission.
 *
 * THIS SOFTWARE IS PROVIDED BY THE COPYRIGHT HOLDERS AND CONTRIBUTORS "AS IS" AND
 * ANY EXPRESS OR IMPLIED WARRANTIES, INCLUDING, BUT NOT LIMITED TO, THE IMPLIED
 * WARRANTIES OF MERCHANTABILITY AND FITNESS FOR A PARTICULAR PURPOSE ARE
 * DISCLAIMED. IN NO EVENT SHALL THE COPYRIGHT OWNER OR CONTRIBUTORS BE LIABLE FOR
 * ANY DIRECT, INDIRECT, INCIDENTAL, SPECIAL, EXEMPLARY, OR CONSEQUENTIAL DAMAGES
 * (INCLUDING, BUT NOT LIMITED TO, PROCUREMENT OF SUBSTITUTE GOODS OR SERVICES;
 * LOSS OF USE, DATA, OR PROFITS; OR BUSINESS INTERRUPTION) HOWEVER CAUSED AND ON
 * ANY THEORY OF LIABILITY, WHETHER IN CONTRACT, STRICT LIABILITY, OR TORT
 * (INCLUDING NEGLIGENCE OR OTHERWISE) ARISING IN ANY WAY OUT OF THE USE OF THIS
 * SOFTWARE, EVEN IF ADVISED OF THE POSSIBILITY OF SUCH DAMAGE.
 *
 * Author: Daniel Hope <daniel.hope@smartalock.com>
 */

#include "crypto.h"

#include <stdlib.h>
#include <stdint.h>
#include <stdbool.h>

void crypto_zero(void *dest, size_t len) {
	volatile uint8_t *p = (uint8_t *)dest;
	while (len--) {
		*p++ = 0;
	}
}

bool crypto_equal(const uint8_t *a, const uint8_t *b, size_t size) {
	uint8_t neq = 0;
	while (size > 0) {
		neq |= *(uint8_t *)a ^ *(uint8_t *)b;
		a += 1;
		b += 1;
		size -= 1;
	}
	return (neq) ? false : true;
}
```

## src/crypto.h
```c
#ifndef _CRYPTO_H_
#define _CRYPTO_H_

#include <stdlib.h>
#include <stdint.h>
#include <stdbool.h>

// BLAKE2S IMPLEMENTATION
#include "crypto/blake2s.h"
#define wireguard_blake2s_ctx blake2s_ctx
#define wireguard_blake2s_init(ctx,outlen,key,keylen) blake2s_init(ctx,outlen,key,keylen)
#define wireguard_blake2s_update(ctx,in,inlen) blake2s_update(ctx,in,inlen)
#define wireguard_blake2s_final(ctx,out) blake2s_final(ctx,out)
#define wireguard_blake2s(out,outlen,key,keylen,in,inlen) blake2s(out,outlen,key,keylen,in,inlen)

// X25519 IMPLEMENTATION
#include "crypto/x25519.h"
#define wireguard_x25519(a,b,c)	x25519(a,b,c,1)

//#include "crypto/cortex/scalarmult.h"
//#define wireguard_x25519(a,b,c)	crypto_scalarmult_curve25519(a,b,c)

// CHACHA20POLY1305 IMPLEMENTATION
#include "crypto/chacha20poly1305.h"
#define wireguard_aead_encrypt(dst,src,srclen,ad,adlen,nonce,key) chacha20poly1305_encrypt(dst,src,srclen,ad,adlen,nonce,key)
#define wireguard_aead_decrypt(dst,src,srclen,ad,adlen,nonce,key) chacha20poly1305_decrypt(dst,src,srclen,ad,adlen,nonce,key)
#define wireguard_xaead_encrypt(dst,src,srclen,ad,adlen,nonce,key) xchacha20poly1305_encrypt(dst,src,srclen,ad,adlen,nonce,key)
#define wireguard_xaead_decrypt(dst,src,srclen,ad,adlen,nonce,key) xchacha20poly1305_decrypt(dst,src,srclen,ad,adlen,nonce,key)


// Endian / unaligned helper macros
#define U8C(v) (v##U)
#define U32C(v) (v##U)

#define U8V(v) ((uint8_t)(v) & U8C(0xFF))
#define U32V(v) ((uint32_t)(v) & U32C(0xFFFFFFFF))

#define U8TO32_LITTLE(p) \
  (((uint32_t)((p)[0])      ) | \
   ((uint32_t)((p)[1]) <<  8) | \
   ((uint32_t)((p)[2]) << 16) | \
   ((uint32_t)((p)[3]) << 24))

#define U8TO64_LITTLE(p) \
  (((uint64_t)((p)[0])      ) | \
   ((uint64_t)((p)[1]) <<  8) | \
   ((uint64_t)((p)[2]) << 16) | \
   ((uint64_t)((p)[3]) << 24) | \
   ((uint64_t)((p)[4]) << 32) | \
   ((uint64_t)((p)[5]) << 40) | \
   ((uint64_t)((p)[6]) << 48) | \
   ((uint64_t)((p)[7]) << 56))

#define U16TO8_BIG(p, v) \
  do { \
    (p)[1] = U8V((v)      ); \
    (p)[0] = U8V((v) >>  8); \
  } while (0)

#define U32TO8_LITTLE(p, v) \
  do { \
    (p)[0] = U8V((v)      ); \
    (p)[1] = U8V((v) >>  8); \
    (p)[2] = U8V((v) >> 16); \
    (p)[3] = U8V((v) >> 24); \
  } while (0)

#define U32TO8_BIG(p, v) \
  do { \
    (p)[3] = U8V((v)      ); \
    (p)[2] = U8V((v) >>  8); \
    (p)[1] = U8V((v) >> 16); \
    (p)[0] = U8V((v) >> 24); \
  } while (0)

#define U64TO8_LITTLE(p, v) \
  do { \
    (p)[0] = U8V((v)      ); \
    (p)[1] = U8V((v) >>  8); \
    (p)[2] = U8V((v) >> 16); \
    (p)[3] = U8V((v) >> 24); \
    (p)[4] = U8V((v) >> 32); \
    (p)[5] = U8V((v) >> 40); \
    (p)[6] = U8V((v) >> 48); \
    (p)[7] = U8V((v) >> 56); \
} while (0)

#define U64TO8_BIG(p, v) \
  do { \
    (p)[7] = U8V((v)      ); \
    (p)[6] = U8V((v) >>  8); \
    (p)[5] = U8V((v) >> 16); \
    (p)[4] = U8V((v) >> 24); \
    (p)[3] = U8V((v) >> 32); \
    (p)[2] = U8V((v) >> 40); \
    (p)[1] = U8V((v) >> 48); \
    (p)[0] = U8V((v) >> 56); \
} while (0)


void crypto_zero(void *dest, size_t len);
bool crypto_equal(const uint8_t *a, const uint8_t *b, size_t size);

#endif /* _CRYPTO_H_ */
```

## src/dhcpc.c
```c
/* Networking DHCPv4 client */
/*
 * Copyright (c) 2024 Chunghan Yi <chunghan.yi@gmail.com>
 * Copyright (c) 2017 ARM Ltd.
 * Copyright (c) 2016 Intel Corporation.
 *
 * SPDX-License-Identifier: Apache-2.0
 */

#include <zephyr/logging/log.h>
LOG_MODULE_DECLARE(wg, LOG_LEVEL_DBG);

#include <zephyr/kernel.h>
#include <zephyr/linker/sections.h>
#include <errno.h>
#include <stdio.h>

#include <zephyr/net/net_if.h>
#include <zephyr/net/net_core.h>
#include <zephyr/net/net_context.h>
#include <zephyr/net/net_mgmt.h>

#define DHCP_OPTION_NTP (42)

static uint8_t ntp_server[4];
static struct net_mgmt_event_callback mgmt_cb;
static struct net_dhcpv4_option_callback dhcp_cb;

static void start_dhcpv4_client(struct net_if *iface, void *user_data)
{
	ARG_UNUSED(user_data);

	LOG_INF("Start on %s: index=%d", net_if_get_device(iface)->name,
		net_if_get_by_iface(iface));
	net_dhcpv4_start(iface);
}

static void handler(struct net_mgmt_event_callback *cb,
		    uint32_t mgmt_event,
		    struct net_if *iface)
{
	int i = 0;

	if (mgmt_event != NET_EVENT_IPV4_ADDR_ADD) {
		return;
	}

	for (i = 0; i < NET_IF_MAX_IPV4_ADDR; i++) {
		char buf[NET_IPV4_ADDR_LEN];

		if (iface->config.ip.ipv4->unicast[i].ipv4.addr_type !=
							NET_ADDR_DHCP) {
			continue;
		}

		LOG_INF("   Address[%d]: %s", net_if_get_by_iface(iface),
			net_addr_ntop(AF_INET,
			    &iface->config.ip.ipv4->unicast[i].ipv4.address.in_addr,
						  buf, sizeof(buf)));
		LOG_INF("    Subnet[%d]: %s", net_if_get_by_iface(iface),
			net_addr_ntop(AF_INET,
				       &iface->config.ip.ipv4->unicast[i].netmask,
				       buf, sizeof(buf)));
		LOG_INF("    Router[%d]: %s", net_if_get_by_iface(iface),
			net_addr_ntop(AF_INET,
						 &iface->config.ip.ipv4->gw,
						 buf, sizeof(buf)));
		LOG_INF("Lease time[%d]: %u seconds", net_if_get_by_iface(iface),
			iface->config.dhcpv4.lease_time);
	}
}

static void option_handler(struct net_dhcpv4_option_callback *cb,
			   size_t length,
			   enum net_dhcpv4_msg_type msg_type,
			   struct net_if *iface)
{
	char buf[NET_IPV4_ADDR_LEN];

	LOG_INF("DHCP Option %d: %s", cb->option,
		net_addr_ntop(AF_INET, cb->data, buf, sizeof(buf)));
}

int init_dhcp4_client(void)
{
	LOG_INF("Run dhcpv4 client");

	net_mgmt_init_event_callback(&mgmt_cb, handler,
				     NET_EVENT_IPV4_ADDR_ADD);
	net_mgmt_add_event_callback(&mgmt_cb);

	net_dhcpv4_init_option_callback(&dhcp_cb, option_handler,
					DHCP_OPTION_NTP, ntp_server,
					sizeof(ntp_server));

	net_dhcpv4_add_option_callback(&dhcp_cb);

	net_if_foreach(start_dhcpv4_client, NULL);
	return 0;
}
```

## src/wg_comm.c
```c
/* UDP packet reception codes */
/*
 * Copyright (c) 2024 Chunghan Yi <chunghan.yi@gmail.com>
 * Copyright (c) 2018 Nordic Semiconductor ASA.
 * Copyright (c) 2017 Intel Corporation.
 *
 * SPDX-License-Identifier: Apache-2.0
 */

#include <zephyr/logging/log.h>
LOG_MODULE_DECLARE(wg, LOG_LEVEL_DBG);

#include <zephyr/kernel.h>
#include <errno.h>
#include <stdio.h>

#include <zephyr/net/socket.h>

#include "common.h"
#include "wireguardif.h"

extern struct netif *wg_netif;

static void process_udp4(void);

K_THREAD_DEFINE(udp4_thread_id, STACK_SIZE,
		process_udp4, NULL, NULL, NULL,
		THREAD_PRIORITY,
		IS_ENABLED(CONFIG_USERSPACE) ? K_USER : 0, -1);

static int start_udp_proto(struct data *data, struct sockaddr *bind_addr,
			   socklen_t bind_addrlen)
{
	int ret;

	data->udp.sock = socket(bind_addr->sa_family, SOCK_DGRAM, IPPROTO_UDP);
	if (data->udp.sock < 0) {
		NET_ERR("Failed to create UDP socket (%s): %d", data->proto, errno);
		return -errno;
	}

	ret = bind(data->udp.sock, bind_addr, bind_addrlen);
	if (ret < 0) {
		NET_ERR("Failed to bind UDP socket (%s): %d", data->proto, errno);
		ret = -errno;
	}

	return ret;
}

static int process_udp(struct data *data)
{
	int ret = 0;
	int r;
	struct pbuf u;
	struct sockaddr_in unknownaddr;
	socklen_t len = sizeof(struct sockaddr_in);
	ip_addr_t addr;
	struct wireguard_device *device = (struct wireguard_device *)(wg_netif->state);

	//NET_INFO("Waiting for UDP packets on port %d (%s)...", WG_PORT, data->proto);

	size_t u_len = 2048; /* TBD */
	u.payload = malloc(u_len);

	do {
		r = recvfrom(data->udp.sock, u.payload, u_len,
				0, (struct sockaddr *)&unknownaddr, &len);
		if (r < 0) {
			NET_ERR("UDP (%s): Connection error %d", data->proto, errno);
			ret = -errno;
			break;
		} else if (r) {
			atomic_add(&data->udp.bytes_received, r);
		}

		NET_DBG("<<  Received a UDP packet: size %d from %s:%d",
				r, inet_ntoa(unknownaddr.sin_addr), ntohs(unknownaddr.sin_port));
		u.len = u.tot_len = r;
		addr.u_addr.ip4.addr = unknownaddr.sin_addr.s_addr;
		wireguardif_network_rx(device, &u, &addr, ntohs(unknownaddr.sin_port));
	} while (true);

	if (u.payload)
		free(u.payload);
	return ret;
}

static void process_udp4(void)
{
	int ret;
	struct sockaddr_in addr4;

	(void)memset(&addr4, 0, sizeof(addr4));
	addr4.sin_family = AF_INET;
	addr4.sin_port = htons(WG_PORT);

	ret = start_udp_proto(&conf.ipv4, (struct sockaddr *)&addr4, sizeof(addr4));
	if (ret < 0) {
		quit();
		return;
	}

	if (wg_netif == NULL) {
		quit();
		return;
	}
	wg_netif->sockfd = conf.ipv4.udp.sock;

	while (ret == 0) {
		ret = process_udp(&conf.ipv4);
		if (ret < 0) {
			quit();
		}
	}
}

static void print_stats(struct k_work *work)
{
	struct k_work_delayable *dwork = k_work_delayable_from_work(work);
	struct data *data = CONTAINER_OF(dwork, struct data, udp.stats_print);
	int total_received = atomic_get(&data->udp.bytes_received);

	if (total_received) {
		if ((total_received / STATS_TIMER) < 1024) {
			LOG_INF("%s UDP: Received %d B/sec", data->proto,
				total_received / STATS_TIMER);
		} else {
			LOG_INF("%s UDP: Received %d KiB/sec", data->proto,
				total_received / 1024 / STATS_TIMER);
		}

		atomic_set(&data->udp.bytes_received, 0);
	}

	k_work_reschedule(&data->udp.stats_print, K_SECONDS(STATS_TIMER));
}

void start_udp(void)
{
	if (IS_ENABLED(CONFIG_NET_IPV4)) {
#if defined(CONFIG_USERSPACE)
		k_mem_domain_add_thread(&app_domain, udp4_thread_id);
#endif

		k_work_init_delayable(&conf.ipv4.udp.stats_print, print_stats);
		k_thread_name_set(udp4_thread_id, "udp4");
		k_thread_start(udp4_thread_id);
		k_work_reschedule(&conf.ipv4.udp.stats_print,
				  K_SECONDS(STATS_TIMER));
	}
}

void stop_udp(void)
{
	/* Not very graceful way to close a thread, but as we may be blocked
	 * in recvfrom call it seems to be necessary
	 */
	if (IS_ENABLED(CONFIG_NET_IPV4)) {
		k_thread_abort(udp4_thread_id);
		if (conf.ipv4.udp.sock >= 0) {
			(void)close(conf.ipv4.udp.sock);
		}
	}
}
```

## src/wg_main.c
```c
/* wireguard startup codes */
/*
 * Copyright (c) 2024 Chunghan Yi <chunghan.yi@gmail.com>
 * Copyright (c) 2018 Nordic Semiconductor ASA.
 * Copyright (c) 2016 Intel Corporation.
 *
 * SPDX-License-Identifier: Apache-2.0
 */

#include <zephyr/logging/log.h>
LOG_MODULE_REGISTER(wg, LOG_LEVEL_DBG);

#include <zephyr/kernel.h>
#include <zephyr/linker/sections.h>
#include <errno.h>
#include <zephyr/shell/shell.h>

#include <zephyr/net/net_core.h>

#include <zephyr/net/net_mgmt.h>
#include <zephyr/net/net_event.h>
#include <zephyr/net/conn_mgr_monitor.h>

#include "common.h"
#include "wireguard_vpn.h"
#include "wireguardif.h"
#include "wg_timer.h"

#define APP_BANNER "wireguard"

int init_dhcp4_client(void);

static struct k_sem quit_lock;
static struct net_mgmt_event_callback mgmt_cb;
static bool connected;
K_SEM_DEFINE(run_app, 0, 1);
static bool want_to_quit;

#if defined(CONFIG_USERSPACE)
K_APPMEM_PARTITION_DEFINE(app_partition);
struct k_mem_domain app_domain;
#endif

#define EVENT_MASK (NET_EVENT_L4_CONNECTED | \
		    NET_EVENT_L4_DISCONNECTED)

APP_DMEM struct configs conf = {
	.ipv4 = {
		.proto = "IPv4",
	},
};

struct netif *wg_netif = NULL;

void quit(void)
{
	k_sem_give(&quit_lock);
}

static void start_udp_service(void)
{
	LOG_INF("Starting udp service...");

	if (IS_ENABLED(CONFIG_NET_UDP)) {
		start_udp();
	}
}

static void stop_udp_service(void)
{
	LOG_INF("Stopping udp service...");

	if (IS_ENABLED(CONFIG_NET_UDP)) {
		stop_udp();
	}
}

static void event_handler(struct net_mgmt_event_callback *cb,
			  uint32_t mgmt_event, struct net_if *iface)
{
	//ARG_UNUSED(iface);
	ARG_UNUSED(cb);

	if (wg_netif) {
		wg_netif->eth_if = iface;
	}

	if ((mgmt_event & EVENT_MASK) != mgmt_event) {
		return;
	}

	if (want_to_quit) {
		k_sem_give(&run_app);
		want_to_quit = false;
	}

	if (mgmt_event == NET_EVENT_L4_CONNECTED) {
		LOG_INF("Network connected");

		connected = true;
		k_sem_give(&run_app);

		return;
	}

	if (mgmt_event == NET_EVENT_L4_DISCONNECTED) {
		if (connected == false) {
			LOG_INF("Waiting network to be connected");
		} else {
			LOG_INF("Network disconnected");
			connected = false;
		}

		k_sem_reset(&run_app);

		return;
	}
}

static void init_app(void)
{
#if defined(CONFIG_USERSPACE)
	struct k_mem_partition *parts[] = {
#if Z_LIBC_PARTITION_EXISTS
		&z_libc_partition,
#endif
		&app_partition
	};

	int ret = k_mem_domain_init(&app_domain, ARRAY_SIZE(parts), parts);

	__ASSERT(ret == 0, "k_mem_domain_init() failed %d", ret);
	ARG_UNUSED(ret);
#endif

	k_sem_init(&quit_lock, 0, K_SEM_MAX_LIMIT);

	LOG_INF(APP_BANNER);

	wg_netif = (struct netif *)malloc(sizeof(struct netif));
	if (wg_netif == NULL) {
		LOG_ERR("Could not allocate struct netif");
	}

	if (IS_ENABLED(CONFIG_NET_CONNECTION_MANAGER)) {
		net_mgmt_init_event_callback(&mgmt_cb,
					     event_handler, EVENT_MASK);
		net_mgmt_add_event_callback(&mgmt_cb);

		conn_mgr_mon_resend_status();
	}

	init_dhcp4_client();
	wireguard_setup();
	init_tunnel();
}

static int cmd_quit(const struct shell *sh,
			  size_t argc, char *argv[])
{
	want_to_quit = true;

	conn_mgr_mon_resend_status();

	quit();

	return 0;
}

SHELL_STATIC_SUBCMD_SET_CREATE(sample_commands,
	SHELL_CMD(quit, NULL,
		  "Quit the WG application\n",
		  cmd_quit),
	SHELL_SUBCMD_SET_END
);

SHELL_CMD_REGISTER(sample, &sample_commands,
		   "WG application commands", NULL);

int main(void)
{
	init_app();

	if (!IS_ENABLED(CONFIG_NET_CONNECTION_MANAGER)) {
		/* If the config library has not been configured to start the
		 * app only after we have a connection, then we can start
		 * it right away.
		 */
		k_sem_give(&run_app);
	}

	/* Wait for the connection. */
	k_sem_take(&run_app, K_FOREVER);

	start_udp_service();

	k_sem_take(&quit_lock, K_FOREVER);

	if (connected) {
		stop_udp_service();
	}

	stop_wg_timer();
	if (wg_netif)
		free(wg_netif);
	return 0;
}
```

## src/wg_timer.c
```c
/*
 * Copyright (c) 2024 Chunghan Yi <chunghan.yi@gmail.com>
 *
 * SPDX-License-Identifier: Apache-2.0
 */

#include <zephyr/kernel.h>
#include <zephyr/version.h>
#include <zephyr/logging/log.h>
LOG_MODULE_DECLARE(wg, LOG_LEVEL_DBG);

extern void wireguardif_tmr(struct k_timer *timer);

K_TIMER_DEFINE(wg_timer, wireguardif_tmr, NULL);

int start_wg_timer(uint32_t period)
{
	k_timer_start(&wg_timer, K_MSEC(period), K_MSEC(period));
	return 0;
}

int stop_wg_timer(void)
{
	k_timer_stop(&wg_timer);
	return 0;
}
```

## src/wg_timer.h
```c
#ifndef _WG_TIMER_H_
#define _WG_TIMER_H_

int start_wg_timer(uint32_t period);
int stop_wg_timer(void);

#endif /*_WG_TIMER_H_*/
```

## src/wg_tun.c
```c
/*
 * Copyright (c) 2024 Chunghan Yi <chunghan.yi@gmail.com>
 * Copyright (c) 2021 Intel Corporation
 *
 * SPDX-License-Identifier: Apache-2.0
 */

#include <zephyr/logging/log.h>
LOG_MODULE_DECLARE(wg, LOG_LEVEL_DBG);

#include <zephyr/kernel.h>
#include <zephyr/device.h>
#include <errno.h>

#include <zephyr/net/net_core.h>
#include <zephyr/net/ethernet.h>
#include <zephyr/net/virtual.h>
#include <zephyr/net/virtual_mgmt.h>

#include "wireguardif.h"
#include "lwip_h/ip4.h"

extern struct netif *wg_netif;

/* User data for the interface callback */
struct ud {
	struct net_if *my_iface;
	struct net_if *ethernet;
};

/* The MTU value here is just an arbitrary number for testing purposes */
#define WIREGUARD_MTU 1420
#define WG_VIRTUAL "zwg"
static const char *dev_name = WG_VIRTUAL;

struct virtual_wg_context {
	struct net_if *iface;
	struct net_if *attached_to;
	bool status;
	bool init_done;
};

static void virtual_wg_iface_init(struct net_if *iface)
{
	struct virtual_wg_context *ctx = net_if_get_device(iface)->data;
	char name[sizeof("zwg-+##########")];
	static int count;

	if (ctx->init_done) {
		return;
	}

	ctx->iface = iface;
	net_if_flag_set(iface, NET_IF_NO_AUTO_START);

	snprintk(name, sizeof(name), "zwg-%d", count + 1);
	count++;
	net_virtual_set_name(iface, name);
	(void)net_virtual_set_flags(iface, NET_L2_POINT_TO_POINT);

	ctx->init_done = true;
}

static struct virtual_wg_context virtual_wg_context_data1 = {
};

static enum virtual_interface_caps
virtual_wg_get_capabilities(struct net_if *iface)
{
	ARG_UNUSED(iface);

	return (enum virtual_interface_caps)0;
}

static int virtual_wg_interface_start(const struct device *dev)
{
	struct virtual_wg_context *ctx = dev->data;

	if (ctx->status) {
		return -EALREADY;
	}

	ctx->status = true;

	LOG_DBG("Starting iface %d", net_if_get_by_iface(ctx->iface));

	return 0;
}

static int virtual_wg_interface_stop(const struct device *dev)
{
	struct virtual_wg_context *ctx = dev->data;

	if (!ctx->status) {
		return -EALREADY;
	}

	ctx->status = false;

	LOG_DBG("Stopping iface %d", net_if_get_by_iface(ctx->iface));

	return 0;
}

static int virtual_wg_interface_send(struct net_if *iface,
				       struct net_pkt *pkt)
{
	struct virtual_wg_context *ctx = net_if_get_device(iface)->data;
	int r;
	struct pbuf u;
	ip_addr_t addr;
	struct ip_hdr *ip;
	int real_len = net_pkt_get_len(pkt);

	if (ctx->attached_to == NULL) {
		return -ENOENT;
	}

	u.payload = pkt->frags->data;
	r = real_len;
	ip = (struct ip_hdr *)u.payload;
	LOG_DBG("<< Sending a VPN message: size %d from SRC = %"PRIu32".%"PRIu32".%"PRIu32".%"PRIu32" to DST = %"PRIu32".%"PRIu32".%"PRIu32".%"PRIu32"",
			r,
			(ntohl(ip->src.addr)  >> 24) & 0xFF,
			(ntohl(ip->src.addr)  >> 16) & 0xFF,
			(ntohl(ip->src.addr)  >>  8) & 0xFF,
			(ntohl(ip->src.addr)  >>  0) & 0xFF,
			(ntohl(ip->dest.addr) >> 24) & 0xFF,
			(ntohl(ip->dest.addr) >> 16) & 0xFF,
			(ntohl(ip->dest.addr) >>  8) & 0xFF,
			(ntohl(ip->dest.addr) >>  0) & 0xFF);

	if (r > 4096) {
		net_pkt_unref(pkt);
		LOG_DBG("Hmm, too big message(r:%d) received.", r);
		return NET_CONTINUE;
	}

	u.len = u.tot_len = r;
	addr.u_addr.ip4.addr = ip->dest.addr;
	wireguardif_output(wg_netif, &u, &addr);

	net_pkt_unref(pkt);
	return NET_CONTINUE;
}

static enum net_verdict virtual_wg_interface_recv(struct net_if *iface,
						    struct net_pkt *pkt)
{
	ARG_UNUSED(iface);
	ARG_UNUSED(pkt);

	return NET_CONTINUE;
}

static int virtual_wg_interface_attach(struct net_if *virtual_iface,
					 struct net_if *iface)
{
	struct virtual_wg_context *ctx = net_if_get_device(virtual_iface)->data;

	LOG_INF("This tunnel interface %d/%p attached to %d/%p",
		net_if_get_by_iface(virtual_iface), virtual_iface,
		net_if_get_by_iface(iface), iface);

	ctx->attached_to = iface;

	return 0;
}

static const struct virtual_interface_api virtual_wg_iface_api = {
	.iface_api.init = virtual_wg_iface_init,

	.get_capabilities = virtual_wg_get_capabilities,
	.start = virtual_wg_interface_start,
	.stop = virtual_wg_interface_stop,
	.send = virtual_wg_interface_send,
	.recv = virtual_wg_interface_recv,
	.attach = virtual_wg_interface_attach,
};

NET_VIRTUAL_INTERFACE_INIT(virtual_wg1, WG_VIRTUAL, NULL, NULL,
			   &virtual_wg_context_data1,
			   NULL,
			   CONFIG_KERNEL_INIT_PRIORITY_DEFAULT,
			   &virtual_wg_iface_api,
			   WIREGUARD_MTU);

static void iface_cb(struct net_if *iface, void *user_data)
{
	struct ud *ud = user_data;

	if ((net_if_l2(iface) != &NET_L2_GET_NAME(ETHERNET)) &&
	    (net_if_l2(iface) != &NET_L2_GET_NAME(VIRTUAL))) {
		return;
	}

	if (!ud->ethernet && net_if_l2(iface) == &NET_L2_GET_NAME(ETHERNET)) {
		ud->ethernet = iface;
		return;
	}

	if (!ud->my_iface && net_if_l2(iface) == &NET_L2_GET_NAME(VIRTUAL) &&
	    net_if_get_device(iface)->data == &virtual_wg_context_data1) {
		ud->my_iface = iface;
		return;
	}
}

static int setup_iface(struct net_if *iface,
		       const char *ipv6_addr,
		       const char *ipv4_addr,
		       const char *peer6addr,
		       const char *peer4addr,
		       const char *netmask)
{
	struct virtual_interface_req_params params = { 0 };
	struct net_if_addr *ifaddr;
	struct in_addr addr4;
	int ret;

	if (IS_ENABLED(CONFIG_NET_IPV4) &&
	    net_if_flag_is_set(iface, NET_IF_IPV4)) {

		if (net_addr_pton(AF_INET, ipv4_addr, &addr4)) {
			LOG_ERR("Invalid address: %s", ipv4_addr);
			return -EINVAL;
		}

		ifaddr = net_if_ipv4_addr_add(iface, &addr4,
					      NET_ADDR_MANUAL, 0);
		if (!ifaddr) {
			LOG_ERR("Cannot add %s to interface %p",
				ipv4_addr, iface);
			return -EINVAL;
		}

		if (netmask) {
			struct in_addr nm;

			if (net_addr_pton(AF_INET, netmask, &nm)) {
				LOG_ERR("Invalid netmask: %s", netmask);
				return -EINVAL;
			}

			net_if_ipv4_set_netmask_by_addr(iface, &addr4, &nm);
		}

		if (!peer4addr || *peer4addr == '\0') {
			goto done;
		}

		params.family = AF_INET;

		if (net_addr_pton(AF_INET, peer4addr, &addr4)) {
			LOG_ERR("Cannot parse peer %s address %s to tunnel",
				"IPv4", peer4addr);
		} else {
			net_ipaddr_copy(&params.peer4addr, &addr4);

			ret = net_mgmt(
				NET_REQUEST_VIRTUAL_INTERFACE_SET_PEER_ADDRESS,
				iface, &params, sizeof(params));
			if (ret < 0 && ret != -ENOTSUP) {
				LOG_ERR("Cannot set peer %s address %s to "
					"interface %d (%d)",
					"IPv4", peer4addr,
					net_if_get_by_iface(iface),
					ret);
			}
		}

		params.mtu = NET_ETH_MTU - sizeof(struct net_ipv4_hdr);

		ret = net_mgmt(NET_REQUEST_VIRTUAL_INTERFACE_SET_MTU,
			       iface, &params,
			       sizeof(struct virtual_interface_req_params));
		if (ret < 0 && ret != -ENOTSUP) {
			LOG_ERR("Cannot set interface %d MTU to %d (%d)",
				net_if_get_by_iface(iface), params.mtu, ret);
		}
	}

done:
	return 0;
}

int init_tunnel(void)
{
#define MAX_NAME_LEN 32
	char buf[MAX_NAME_LEN];
	struct ud ud;
	int ret;

	LOG_INF("Start tunnel service (dev %s/%p)", dev_name, device_get_binding(dev_name));

	memset(&ud, 0, sizeof(ud));
	net_if_foreach(iface_cb, &ud);

	LOG_INF("Tunnel interface %d (%s / %p)",
		net_if_get_by_iface(ud.my_iface),
		net_virtual_get_name(ud.my_iface, buf, sizeof(buf)),
		ud.my_iface);

#if 0
	LOG_INF("Ethernet interface %d (%p)",
		net_if_get_by_iface(ud.ethernet), ud.ethernet);
#endif

	/* Attach the network interfaces on top of the Ethernet interface */
	net_virtual_interface_attach(ud.my_iface, ud.ethernet);

	ret = setup_iface(ud.my_iface,
			  NULL,
			  CONFIG_NET_CONFIG_VPN_IPV4_ADDR,
			  NULL, NULL,
			  CONFIG_NET_CONFIG_VPN_IPV4_NETMASK);
	if (ret < 0) {
		LOG_ERR("Cannot set IP address to test interface");
	}

	if (wg_netif) {
		wg_netif->tun_if = ud.my_iface;
	}

	return 0;
}
```

## src/wireguard-platform.c
```c
/*
 * Porting for Zephyr RTOS
 * Copyright (C) 2024 Chunghan.Yi(chunghan.yi@gmail.com)
 */
/*
 * Copyright (c) 2021 Daniel Hope (www.floorsense.nz)
 * All rights reserved.
 *
 * Redistribution and use in source and binary forms, with or without modification,
 * are permitted provided that the following conditions are met:
 *
 * 1. Redistributions of source code must retain the above copyright notice, this
 *  list of conditions and the following disclaimer.
 *
 * 2. Redistributions in binary form must reproduce the above copyright notice, this
 *  list of conditions and the following disclaimer in the documentation and/or
 *  other materials provided with the distribution.
 *
 * 3. Neither the name of "Floorsense Ltd", "Agile Workspace Ltd" nor the names of
 *  its contributors may be used to endorse or promote products derived from this
 *   software without specific prior written permission.
 *
 * THIS SOFTWARE IS PROVIDED BY THE COPYRIGHT HOLDERS AND CONTRIBUTORS "AS IS" AND
 * ANY EXPRESS OR IMPLIED WARRANTIES, INCLUDING, BUT NOT LIMITED TO, THE IMPLIED
 * WARRANTIES OF MERCHANTABILITY AND FITNESS FOR A PARTICULAR PURPOSE ARE
 * DISCLAIMED. IN NO EVENT SHALL THE COPYRIGHT OWNER OR CONTRIBUTORS BE LIABLE FOR
 * ANY DIRECT, INDIRECT, INCIDENTAL, SPECIAL, EXEMPLARY, OR CONSEQUENTIAL DAMAGES
 * (INCLUDING, BUT NOT LIMITED TO, PROCUREMENT OF SUBSTITUTE GOODS OR SERVICES;
 * LOSS OF USE, DATA, OR PROFITS; OR BUSINESS INTERRUPTION) HOWEVER CAUSED AND ON
 * ANY THEORY OF LIABILITY, WHETHER IN CONTRACT, STRICT LIABILITY, OR TORT
 * (INCLUDING NEGLIGENCE OR OTHERWISE) ARISING IN ANY WAY OUT OF THE USE OF THIS
 * SOFTWARE, EVEN IF ADVISED OF THE POSSIBILITY OF SUCH DAMAGE.
 *
 * Author: Daniel Hope <daniel.hope@smartalock.com>
 */

#include "wireguard-platform.h"

#include <stdlib.h>

#include "crypto.h"
#include <sys/time.h>
#include <stdlib.h>
#include <time.h>

// This file contains a sample Wireguard platform integration

// DO NOT USE THIS FUNCTION - IMPLEMENT A BETTER RANDOM BYTE GENERATOR IN YOUR IMPLEMENTATION
void wireguard_random_bytes(void *bytes, size_t size) {
	srand(time(NULL));
	for (unsigned int i=0; i<size; i++) {
		((char *)bytes)[i] = rand() % size;
	}
}

uint32_t wireguard_sys_now() {
	struct timeval te;
	gettimeofday(&te, NULL); // get current time
	long long milliseconds = te.tv_sec*1000LL + te.tv_usec/1000;
	return milliseconds;
}

// CHANGE THIS TO GET THE ACTUAL UNIX TIMESTMP IN MILLIS - HANDSHAKES WILL FAIL IF THIS DOESN'T INCREASE EACH TIME CALLED
void wireguard_tai64n_now(uint8_t *output) {
	// See https://cr.yp.to/libtai/tai64.html
	// 64 bit seconds from 1970 = 8 bytes
	// 32 bit nano seconds from current second

	uint64_t millis = wireguard_sys_now();

	// Split into seconds offset + nanos
	uint64_t seconds = 0x400000000000000aULL + (millis / 1000);
	uint32_t nanos = (millis % 1000) * 1000;
	U64TO8_BIG(output + 0, seconds);
	U32TO8_BIG(output + 8, nanos);
}

bool wireguard_is_under_load() {
	return false;
}
```

## src/wireguard.h
```c
/*
 * Porting for Zephyr RTOS
 * Copyright (C) 2024 Chunghan.Yi(chunghan.yi@gmail.com)
 */
/*
 * Copyright (c) 2021 Daniel Hope (www.floorsense.nz)
 * All rights reserved.
 *
 * Redistribution and use in source and binary forms, with or without modification,
 * are permitted provided that the following conditions are met:
 *
 * 1. Redistributions of source code must retain the above copyright notice, this
 *  list of conditions and the following disclaimer.
 *
 * 2. Redistributions in binary form must reproduce the above copyright notice, this
 *  list of conditions and the following disclaimer in the documentation and/or
 *  other materials provided with the distribution.
 *
 * 3. Neither the name of "Floorsense Ltd", "Agile Workspace Ltd" nor the names of
 *  its contributors may be used to endorse or promote products derived from this
 *   software without specific prior written permission.
 *
 * THIS SOFTWARE IS PROVIDED BY THE COPYRIGHT HOLDERS AND CONTRIBUTORS "AS IS" AND
 * ANY EXPRESS OR IMPLIED WARRANTIES, INCLUDING, BUT NOT LIMITED TO, THE IMPLIED
 * WARRANTIES OF MERCHANTABILITY AND FITNESS FOR A PARTICULAR PURPOSE ARE
 * DISCLAIMED. IN NO EVENT SHALL THE COPYRIGHT OWNER OR CONTRIBUTORS BE LIABLE FOR
 * ANY DIRECT, INDIRECT, INCIDENTAL, SPECIAL, EXEMPLARY, OR CONSEQUENTIAL DAMAGES
 * (INCLUDING, BUT NOT LIMITED TO, PROCUREMENT OF SUBSTITUTE GOODS OR SERVICES;
 * LOSS OF USE, DATA, OR PROFITS; OR BUSINESS INTERRUPTION) HOWEVER CAUSED AND ON
 * ANY THEORY OF LIABILITY, WHETHER IN CONTRACT, STRICT LIABILITY, OR TORT
 * (INCLUDING NEGLIGENCE OR OTHERWISE) ARISING IN ANY WAY OUT OF THE USE OF THIS
 * SOFTWARE, EVEN IF ADVISED OF THE POSSIBILITY OF SUCH DAMAGE.
 *
 * Author: Daniel Hope <daniel.hope@smartalock.com>
 */

#ifndef _WIREGUARD_H_
#define _WIREGUARD_H_

#include <stdint.h>
#include <stdlib.h>
#include <stdbool.h>

// Note: these are only required for definitions in device/peer for netif, udp_pcb, ip_addr_t and u16_t
#include "lwip_h/arch.h"
#include "lwip_h/ip_addr.h"

// Platform-specific functions that need to be implemented per-platform
#include "wireguard-platform.h"

// tai64n contains 64-bit seconds and 32-bit nano offset (12 bytes)
#define WIREGUARD_TAI64N_LEN		(12)
// Auth algorithm is chacha20pol1305 which is 128bit (16 byte) authenticator
#define WIREGUARD_AUTHTAG_LEN		(16)
// Hash algorithm is blake2s which makes 32 byte hashes
#define WIREGUARD_HASH_LEN			(32)
// Public key algo is curve22519 which uses 32 byte keys
#define WIREGUARD_PUBLIC_KEY_LEN	(32)
// Public key algo is curve22519 which uses 32 byte keys
#define WIREGUARD_PRIVATE_KEY_LEN	(32)
// Symmetric session keys are chacha20/poly1305 which uses 32 byte keys
#define WIREGUARD_SESSION_KEY_LEN	(32)

// Timers / Limits
#define WIREGUARD_COOKIE_LEN		(16)
#define COOKIE_SECRET_MAX_AGE		(2 * 60)
#define COOKIE_NONCE_LEN			(24)

#define REKEY_AFTER_MESSAGES		(1ULL << 60)
#define REJECT_AFTER_MESSAGES		(0xFFFFFFFFFFFFFFFFULL - (1ULL << 13))
#define REKEY_AFTER_TIME			(120)
#define REJECT_AFTER_TIME			(180)
#define REKEY_TIMEOUT				(5)
#define KEEPALIVE_TIMEOUT			(10)

struct wireguard_keypair {
	bool valid;
	bool initiator; // Did we initiate this session (send the initiation packet rather than sending the response packet)
	uint32_t keypair_millis;

	uint8_t sending_key[WIREGUARD_SESSION_KEY_LEN];
	bool sending_valid;
	uint64_t sending_counter;

	uint8_t receiving_key[WIREGUARD_SESSION_KEY_LEN];
	bool receiving_valid;

	uint32_t last_tx;
	uint32_t last_rx;

	uint32_t replay_bitmap;
	uint64_t replay_counter;

	uint32_t local_index; // This is the index we generated for our end
	uint32_t remote_index; // This is the index on the other end
};

struct wireguard_handshake {
	bool valid;
	bool initiator;
	uint32_t local_index;
	uint32_t remote_index;
	uint8_t ephemeral_private[WIREGUARD_PRIVATE_KEY_LEN];
	uint8_t remote_ephemeral[WIREGUARD_PUBLIC_KEY_LEN];
	uint8_t hash[WIREGUARD_HASH_LEN];
	uint8_t chaining_key[WIREGUARD_HASH_LEN];
};

struct wireguard_allowed_ip {
	bool valid;
	ip_addr_t ip;
	ip_addr_t mask;
};

struct wireguard_peer {
	bool valid; // Is this peer initialised?
	bool active; // Should we be actively trying to connect?

	// This is the configured IP of the peer (endpoint)
	ip_addr_t connect_ip;
	u16_t connect_port;
	// This is the latest received IP/port
	ip_addr_t ip;
	u16_t port;
	// keep-alive interval in seconds, 0 is disable
	uint16_t keepalive_interval;

	struct wireguard_allowed_ip allowed_source_ips[WIREGUARD_MAX_SRC_IPS];

	uint8_t public_key[WIREGUARD_PUBLIC_KEY_LEN];
	uint8_t preshared_key[WIREGUARD_SESSION_KEY_LEN];

	// Precomputed DH(Sprivi,Spubr) with device private key, and peer public key
	uint8_t public_key_dh[WIREGUARD_PUBLIC_KEY_LEN];

	// Session keypairs
	struct wireguard_keypair curr_keypair;
	struct wireguard_keypair prev_keypair;
	struct wireguard_keypair next_keypair;

	// 5.1 Silence is a Virtue: The responder keeps track of the greatest timestamp received per peer
	uint8_t greatest_timestamp[WIREGUARD_TAI64N_LEN];

	// The active handshake that is happening
	struct wireguard_handshake handshake;

	// Decrypted cookie from the responder
	uint32_t cookie_millis;
	uint8_t cookie[WIREGUARD_COOKIE_LEN];

	// The latest mac1 we sent with initiation
	bool handshake_mac1_valid;
	uint8_t handshake_mac1[WIREGUARD_COOKIE_LEN];

	// Precomputed keys for use in mac validation
	uint8_t label_cookie_key[WIREGUARD_SESSION_KEY_LEN];
	uint8_t label_mac1_key[WIREGUARD_SESSION_KEY_LEN];

	// The last time we received a valid initiation message
	uint32_t last_initiation_rx;
	// The last time we sent an initiation message to this peer
	uint32_t last_initiation_tx;

	// last_tx and last_rx of data packets
	uint32_t last_tx;
	uint32_t last_rx;

	// We set this flag on RX/TX of packets if we think that we should initiate a new handshake
	bool send_handshake;
};

struct wireguard_device {
	// Maybe have a "Device private" member to abstract these?
	struct netif *netif;

	uint8_t public_key[WIREGUARD_PUBLIC_KEY_LEN];
	uint8_t private_key[WIREGUARD_PRIVATE_KEY_LEN];

	uint8_t cookie_secret[WIREGUARD_HASH_LEN];
	uint32_t cookie_secret_millis;

	// Precalculated
 	uint8_t label_cookie_key[WIREGUARD_SESSION_KEY_LEN];
	uint8_t label_mac1_key[WIREGUARD_SESSION_KEY_LEN];

	// List of peers associated with this device
 	struct wireguard_peer peers[WIREGUARD_MAX_PEERS];

	bool valid;
};

#define MESSAGE_INVALID					0
#define MESSAGE_HANDSHAKE_INITIATION	1
#define MESSAGE_HANDSHAKE_RESPONSE		2
#define MESSAGE_COOKIE_REPLY			3
#define MESSAGE_TRANSPORT_DATA			4


// 5.4.2 First Message: Initiator to Responder
struct message_handshake_initiation {
	uint8_t type;
	uint8_t reserved[3];
	uint32_t sender;
	uint8_t ephemeral[32];
	uint8_t enc_static[32 + WIREGUARD_AUTHTAG_LEN];
	uint8_t enc_timestamp[WIREGUARD_TAI64N_LEN + WIREGUARD_AUTHTAG_LEN];
	uint8_t mac1[WIREGUARD_COOKIE_LEN];
	uint8_t mac2[WIREGUARD_COOKIE_LEN];
} __attribute__ ((__packed__));

// 5.4.3 Second Message: Responder to Initiator
struct message_handshake_response {
	uint8_t type;
	uint8_t reserved[3];
	uint32_t sender;
	uint32_t receiver;
	uint8_t ephemeral[32];
	uint8_t enc_empty[0 + WIREGUARD_AUTHTAG_LEN];
	uint8_t mac1[WIREGUARD_COOKIE_LEN];
	uint8_t mac2[WIREGUARD_COOKIE_LEN];
} __attribute__ ((__packed__));

// 5.4.7 Under Load: Cookie Reply Message
struct message_cookie_reply {
	uint8_t type;
	uint8_t reserved[3];
	uint32_t receiver;
	uint8_t nonce[COOKIE_NONCE_LEN];
	uint8_t enc_cookie[WIREGUARD_COOKIE_LEN + WIREGUARD_AUTHTAG_LEN];
} __attribute__ ((__packed__));

// 5.4.6 Subsequent Messages: Transport Data Messages
struct message_transport_data {
	uint8_t type;
	uint8_t reserved[3];
	uint32_t receiver;
	uint8_t counter[8];
	// Followed by encrypted data
	uint8_t enc_packet[];
} __attribute__ ((__packed__));

// Initialise the WireGuard system - need to call this before anything else
void wireguard_init();
bool wireguard_device_init(struct wireguard_device *device, const uint8_t *private_key);
bool wireguard_peer_init(struct wireguard_device *device, struct wireguard_peer *peer, const uint8_t *public_key, const uint8_t *preshared_key);

struct wireguard_peer *peer_alloc(struct wireguard_device *device);
uint8_t wireguard_peer_index(struct wireguard_device *device, struct wireguard_peer *peer);
struct wireguard_peer *peer_lookup_by_pubkey(struct wireguard_device *device, uint8_t *public_key);
struct wireguard_peer *peer_lookup_by_peer_index(struct wireguard_device *device, uint8_t peer_index);
struct wireguard_peer *peer_lookup_by_receiver(struct wireguard_device *device, uint32_t receiver);
struct wireguard_peer *peer_lookup_by_handshake(struct wireguard_device *device, uint32_t receiver);

void wireguard_start_session(struct wireguard_peer *peer, bool initiator);

void keypair_update(struct wireguard_peer *peer, struct wireguard_keypair *received_keypair);
void keypair_destroy(struct wireguard_keypair *keypair);

struct wireguard_keypair *get_peer_keypair_for_idx(struct wireguard_peer *peer, uint32_t idx);
bool wireguard_check_replay(struct wireguard_keypair *keypair, uint64_t seq);

uint8_t wireguard_get_message_type(const uint8_t *data, size_t len);

struct wireguard_peer *wireguard_process_initiation_message(struct wireguard_device *device, struct message_handshake_initiation *msg);
bool wireguard_process_handshake_response(struct wireguard_device *device, struct wireguard_peer *peer, struct message_handshake_response *src);
bool wireguard_process_cookie_message(struct wireguard_device *device, struct wireguard_peer *peer, struct message_cookie_reply *src);

bool wireguard_create_handshake_initiation(struct wireguard_device *device, struct wireguard_peer *peer, struct message_handshake_initiation *dst);
bool wireguard_create_handshake_response(struct wireguard_device *device, struct wireguard_peer *peer, struct message_handshake_response *dst);
void wireguard_create_cookie_reply(struct wireguard_device *device, struct message_cookie_reply *dst, const uint8_t *mac1, uint32_t index, uint8_t *source_addr_port, size_t source_length);


bool wireguard_check_mac1(struct wireguard_device *device, const uint8_t *data, size_t len, const uint8_t *mac1);
bool wireguard_check_mac2(struct wireguard_device *device, const uint8_t *data, size_t len, uint8_t *source_addr_port, size_t source_length, const uint8_t *mac2);

bool wireguard_expired(uint32_t created_millis, uint32_t valid_seconds);

void wireguard_encrypt_packet(uint8_t *dst, const uint8_t *src, size_t src_len, struct wireguard_keypair *keypair);
bool wireguard_decrypt_packet(uint8_t *dst, const uint8_t *src, size_t src_len, uint64_t counter, struct wireguard_keypair *keypair);

bool wireguard_base64_decode(const char *str, uint8_t *out, size_t *outlen);
bool wireguard_base64_encode(const uint8_t *in, size_t inlen, char *out, size_t *outlen);


#endif /* _WIREGUARD_H_ */
```
